/*
 * ============================================================================
 *  ParkFlow — Automated Parking Gate System
 * ============================================================================
 *  Target   : Arduino UNO R3 (ATmega328P @ 16 MHz)
 *  Sensor   : HC-SR04 ultrasonic ranger   (TRIG -> D9, ECHO -> D10)
 *  Actuator : SG90 micro servo            (SIGNAL -> D6)
 *
 *  Behaviour: a vehicle closer than DETECT_THRESHOLD_CM raises the gate to
 *  90 deg. The gate holds for HOLD_TIME_MS once the lane is clear, then
 *  lowers back to 0 deg. Implemented as a non-blocking finite state machine:
 *
 *      IDLE -> GATE_OPENING -> GATE_HOLD -> GATE_CLOSING -> IDLE
 *                   ^                            |
 *                   +------ vehicle detected ----+   (safety reversal)
 *
 *  delay() is never called: every timed action is scheduled against millis().
 *
 *  License  : MIT (see LICENSE)
 * ============================================================================
 */

#include <Servo.h>

// ---------------------------------------------------------------------------
// Pin map
// ---------------------------------------------------------------------------
const uint8_t PIN_TRIG  = 9;    // HC-SR04 trigger (output)
const uint8_t PIN_ECHO  = 10;   // HC-SR04 echo    (input, 5 V logic)
const uint8_t PIN_SERVO = 6;    // SG90 signal     (pulses generated by Servo.h on Timer1)

// ---------------------------------------------------------------------------
// Tuning knobs: real sensors and servos drift, so calibrate these on the bench
// ---------------------------------------------------------------------------
const float         DETECT_THRESHOLD_CM = 10.0;  // vehicle present when filtered distance < this
const uint8_t       GATE_CLOSED_ANGLE   = 0;     // servo angle, gate down
const uint8_t       GATE_OPEN_ANGLE     = 90;    // servo angle, gate up
const unsigned long HOLD_TIME_MS        = 2000;  // gate stays open this long after the lane clears
const unsigned long SERVO_STEP_MS       = 10;    // 1 deg per step -> 90 deg sweep in ~0.9 s
const unsigned long PING_INTERVAL_MS    = 60;    // HC-SR04 datasheet: >= 60 ms between triggers
const unsigned long ECHO_TIMEOUT_US     = 6000;  // caps pulseIn() blocking time (~1 m max range)

// ---------------------------------------------------------------------------
// Acoustic physics
// ---------------------------------------------------------------------------
// Speed of sound in dry air at 20 C: c = 343 m/s
//   343 m/s * 100 cm/m / 1,000,000 us/s = 0.0343 cm/us
// ECHO stays HIGH for the whole round trip (sensor -> target -> sensor), so
//   distance_cm = t_echo_us * 0.0343 / 2          (~ t_echo_us / 58.3)
//   e.g. the 10 cm threshold  <->  ~583 us echo pulse
// c drifts with air temperature: c ~ 331.3 + 0.606 * T[C] m/s (~0.18 % per C).
// Adjust SOUND_CM_PER_US for sites far from 20 C.
const float SOUND_CM_PER_US = 0.0343;

// ---------------------------------------------------------------------------
// Median filter: rejects single-shot acoustic outliers (multipath, crosstalk,
// missed echoes) that a moving average would smear into the result.
// ---------------------------------------------------------------------------
const uint8_t FILTER_SIZE = 5;          // odd, so the median is always a real sample
unsigned long echoWindow[FILTER_SIZE];  // ring buffer of raw echo widths (us)
uint8_t       echoHead = 0;

// ---------------------------------------------------------------------------
// Finite state machine
// ---------------------------------------------------------------------------
enum GateState : uint8_t { IDLE, GATE_OPENING, GATE_HOLD, GATE_CLOSING };
const char *const STATE_NAMES[] = { "IDLE", "GATE_OPENING", "GATE_HOLD", "GATE_CLOSING" };

Servo         gate;
GateState     state          = IDLE;
uint8_t       gateAngle      = GATE_CLOSED_ANGLE;
bool          vehiclePresent = false;
float         distanceCm     = 0;
unsigned long lastPingMs     = 0;
unsigned long lastStepMs     = 0;
unsigned long stateSinceMs   = 0;

// Fires one ping and returns the echo width in us. Blocks for at most
// ECHO_TIMEOUT_US. The 12 us trigger sequence is part of the sensor protocol,
// not a scheduling delay.
unsigned long pingEchoUs() {
  digitalWrite(PIN_TRIG, LOW);
  delayMicroseconds(2);
  digitalWrite(PIN_TRIG, HIGH);         // >= 10 us HIGH -> 8 x 40 kHz burst
  delayMicroseconds(10);
  digitalWrite(PIN_TRIG, LOW);

  unsigned long us = pulseIn(PIN_ECHO, HIGH, ECHO_TIMEOUT_US);
  return us ? us : ECHO_TIMEOUT_US;     // 0 = timeout = nothing in range -> treat as "far"
}

// Median of the ring buffer (insertion sort on a copy, trivial for N = 5).
unsigned long medianEchoUs() {
  unsigned long s[FILTER_SIZE];
  memcpy(s, echoWindow, sizeof(s));
  for (uint8_t i = 1; i < FILTER_SIZE; i++) {
    unsigned long key = s[i];
    int8_t j = i - 1;
    while (j >= 0 && s[j] > key) {
      s[j + 1] = s[j];
      j--;
    }
    s[j + 1] = key;
  }
  return s[FILTER_SIZE / 2];
}

// Steps the gate 1 deg toward `target` every SERVO_STEP_MS and returns true
// once it gets there. Gradual motion keeps the servo's current spikes low.
// Direction-agnostic, so an inverted mount (OPEN < CLOSED) needs no code change.
bool sweepToward(uint8_t target, unsigned long now) {
  if (gateAngle != target && now - lastStepMs >= SERVO_STEP_MS) {
    lastStepMs = now;
    gateAngle += (target > gateAngle) ? 1 : -1;
    gate.write(gateAngle);
  }
  return gateAngle == target;
}

void enterState(GateState next, unsigned long now) {
  Serial.print(now);
  Serial.print(F(" ms  "));
  Serial.print(STATE_NAMES[state]);
  Serial.print(F(" -> "));
  Serial.print(STATE_NAMES[next]);
  Serial.print(F("  (d = "));
  Serial.print(distanceCm, 1);
  Serial.println(F(" cm)"));

  state = next;
  stateSinceMs = now;
}

void setup() {
  Serial.begin(115200);

  pinMode(PIN_TRIG, OUTPUT);
  pinMode(PIN_ECHO, INPUT);
  digitalWrite(PIN_TRIG, LOW);

  // Pre-fill the filter with "far" so power-up noise cannot open the gate.
  for (uint8_t i = 0; i < FILTER_SIZE; i++) echoWindow[i] = ECHO_TIMEOUT_US;

  // write() before attach() sets the first pulse width, so the gate does not
  // twitch to Servo.h's default 90 deg at power-up.
  gate.write(GATE_CLOSED_ANGLE);
  gate.attach(PIN_SERVO);

  Serial.println(F("ParkFlow ready."));
}

void loop() {
  const unsigned long now = millis();   // unsigned subtraction below is rollover-safe (~49.7 days)

  // 1) Sense: one ping per PING_INTERVAL_MS, then median of the last 5 echoes.
  if (now - lastPingMs >= PING_INTERVAL_MS) {
    lastPingMs = now;
    echoWindow[echoHead] = pingEchoUs();
    echoHead = (echoHead + 1) % FILTER_SIZE;

    distanceCm     = medianEchoUs() * SOUND_CM_PER_US / 2.0;  // halve: round trip
    vehiclePresent = distanceCm < DETECT_THRESHOLD_CM;
  }

  // 2) Decide + actuate: every branch returns immediately, nothing waits.
  switch (state) {
    case IDLE:
      if (vehiclePresent) enterState(GATE_OPENING, now);
      break;

    case GATE_OPENING:
      if (sweepToward(GATE_OPEN_ANGLE, now)) enterState(GATE_HOLD, now);
      break;

    case GATE_HOLD:
      if (vehiclePresent) stateSinceMs = now;  // re-arm while the vehicle is still in the lane
      else if (now - stateSinceMs >= HOLD_TIME_MS) enterState(GATE_CLOSING, now);
      break;

    case GATE_CLOSING:
      if (vehiclePresent) enterState(GATE_OPENING, now);  // safety reversal: never close onto a vehicle
      else if (sweepToward(GATE_CLOSED_ANGLE, now)) enterState(IDLE, now);
      break;
  }
}
